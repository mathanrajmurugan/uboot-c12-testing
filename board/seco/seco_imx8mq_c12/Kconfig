## board/seco/seco_imx8mq_c12/Kconfig
```kconfig
if TARGET_SECO_IMX8MQ_C12

config SYS_BOARD
	default "seco_imx8mq_c12"

config SYS_VENDOR
	default "seco"

config SYS_CONFIG_NAME
	default "seco_imx8mq_c12"

source "board/seco/common/Kconfig"

endif
```

## board/seco/seco_imx8mq_c20/Kconfig
```kconfig
if TARGET_SECO_IMX8MQ_C20 

config SYS_BOARD
	default "seco_imx8mq_c20"

config SYS_VENDOR
	default "seco"

config SYS_CONFIG_NAME
	default "seco_imx8mq_c20"

endif
```

## board/seco/seco_imx8mq_c25/Kconfig
```kconfig
if TARGET_SECO_IMX8MQ_C25

config SYS_BOARD
	default "seco_imx8mq_c25"

config SYS_VENDOR
	default "seco"

config SYS_CONFIG_NAME
	default "seco_imx8mq_c25"

endif
```
